## drivers/input/jdm_sensors/hall/Kconfig
```kconfig
config INPUT_HALL_SENSOR
    bool "input hall sensor"
	depends on INPUT
	select INPUT_KEYCOMBO
	---help---
	  Set Y here and a list of supported hall sensor will be displayed;
```

## drivers/input/sar_abov/Kconfig
```kconfig
config ABOV_SAR_A96T375
	tristate "Abov sar sensor support"
	depends on I2C
	---help---
	 If you say yes here,you will get Abov sar sensor driver
```
