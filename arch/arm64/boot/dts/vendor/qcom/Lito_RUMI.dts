/dts-v1/;

/ {
	model = "Qualcomm Technologies, Inc. Lito RUMI";
	compatible = "qcom,lito-rumi\0qcom,lito\0qcom,rumi";
	qcom,msm-id = <0x190 0x10000>;
	qcom,board-id = <0x0f 0x00>;

	fragment@0 {
		target = <0xffffffff>;

		__overlay__ {

			timer {
				clock-frequency = <0x7a120>;
			};

			timer@17c20000 {
				clock-frequency = <0x7a120>;
			};

			usb_emu_phy@a720000 {
				compatible = "qcom,usb-emu-phy";
				reg = <0xa720000 0x9500 0xa6f8800 0x100>;
				reg-names = "base\0qscratch_base";
				qcom,emu-init-seq = <0xfff0 0x04 0xfff3 0x04 0x40 0x04 0xfff3 0x04 0xfff0 0x04 0x100000 0x20 0x00 0x20 0x1a0 0x20 0x100000 0x3c 0x00 0x3c 0x10060 0x3c 0x00 0x04>;
				phandle = <0x01>;
			};

			bi_tcxo {
				compatible = "fixed-factor-clock";
				clocks = <0xffffffff>;
				clock-mult = <0x01>;
				clock-div = <0x02>;
				#clock-cells = <0x00>;
				phandle = <0x02>;
			};

			bi_tcxo_ao {
				compatible = "fixed-factor-clock";
				clocks = <0xffffffff>;
				clock-mult = <0x01>;
				clock-div = <0x02>;
				#clock-cells = <0x00>;
				phandle = <0x03>;
			};
		};
	};

	fragment@1 {
		target = <0xffffffff>;

		__overlay__ {
			compatible = "qcom,dummycc";
			clock-output-names = "rpmh_clocks";
		};
	};

	fragment@2 {
		target = <0xffffffff>;

		__overlay__ {
			compatible = "qcom,dummycc";
			clock-output-names = "qdss_clocks";
		};
	};

	fragment@3 {
		target = <0xffffffff>;

		__overlay__ {

			dwc3@a600000 {
				usb-phy = <0x01 0xffffffff>;
				maximum-speed = "high-speed";
			};
		};
	};

	fragment@4 {
		target = <0xffffffff>;

		__overlay__ {

			hsphy@88e3000 {
				status = "disabled";
			};
		};
	};

	fragment@5 {
		target = <0xffffffff>;

		__overlay__ {
			status = "disabled";
		};
	};

	fragment@6 {
		target = <0xffffffff>;

		__overlay__ {
			status = "ok";
		};
	};

	fragment@7 {
		target = <0xffffffff>;

		__overlay__ {
			status = "disabled";
		};
	};

	fragment@8 {
		target = <0xffffffff>;

		__overlay__ {
			compatible = "qcom,ufs-phy-qrbtc-sdm845";
			vdda-phy-supply = <0xffffffff>;
			vdda-pll-supply = <0xffffffff>;
			vdda-phy-max-microamp = <0x16058>;
			vdda-pll-max-microamp = <0x4a38>;
			status = "ok";
		};
	};

	fragment@9 {
		target = <0xffffffff>;

		__overlay__ {
			limit-tx-hs-gear = <0x01>;
			limit-rx-hs-gear = <0x01>;
			vdd-hba-supply = <0xffffffff>;
			vdd-hba-fixed-regulator;
			vcc-supply = <0xffffffff>;
			vccq2-supply = <0xffffffff>;
			vcc-max-microamp = "\0\f5";
			vccq2-max-microamp = "\0\f5";
			qcom,vddp-ref-clk-supply = <0xffffffff>;
			qcom,vddp-ref-clk-max-microamp = <0x64>;
			qcom,disable-lpm;
			rpm-level = <0x00>;
			spm-level = <0x00>;
			status = "ok";
		};
	};

	fragment@10 {
		target = <0xffffffff>;

		__overlay__ {
			vdd-supply = <0xffffffff>;
			qcom,vdd-voltage-level = <0x2d0370 0x2d0370>;
			qcom,vdd-current-level = <0x00 0x8b290>;
			vdd-io-supply = <0xffffffff>;
			qcom,vdd-io-always-on;
			qcom,vdd-io-lpm-sup;
			qcom,vdd-io-voltage-level = <0x1b7740 0x1b7740>;
			qcom,vdd-io-current-level = <0x00 0x4f588>;
			pinctrl-names = "active\0sleep";
			pinctrl-0 = <0xffffffff 0xffffffff 0xffffffff 0xffffffff>;
			pinctrl-1 = <0xffffffff 0xffffffff 0xffffffff 0xffffffff>;
			qcom,clk-rates = <0x61a80 0x1312d00 0x17d7840 0x2faf080>;
			qcom,bus-speed-mode = "DDR_1p8v";
			status = "ok";
		};
	};

	fragment@11 {
		target = <0xffffffff>;

		__overlay__ {
			vdd-supply = <0xffffffff>;
			qcom,vdd-voltage-level = <0x2d0370 0x2d0370>;
			qcom,vdd-current-level = <0x00 0xc3500>;
			vdd-io-supply = <0xffffffff>;
			qcom,vdd-io-voltage-level = <0x1b7740 0x2d0370>;
			qcom,vdd-io-current-level = <0x00 0x55f0>;
			pinctrl-names = "active\0sleep";
			pinctrl-0 = <0xffffffff 0xffffffff 0xffffffff>;
			pinctrl-1 = <0xffffffff 0xffffffff 0xffffffff>;
			qcom,clk-rates = <0x61a80 0x1312d00 0x17d7840 0x2faf080>;
			qcom,bus-speed-mode = "SDR12\0SDR25\0SDR50";
			status = "ok";
		};
	};

	fragment@12 {
		target = <0xffffffff>;

		__overlay__ {
			status = "disabled";
		};
	};

	__symbols__ {
		usb_emu_phy = "/fragment@0/__overlay__/usb_emu_phy@a720000";
		cxo = "/fragment@0/__overlay__/bi_tcxo";
		cxo_a = "/fragment@0/__overlay__/bi_tcxo_ao";
	};

	__fixups__ {
		soc = "/fragment@0:target:0";
		xo_board = "/fragment@0/__overlay__/bi_tcxo:clocks:0\0/fragment@0/__overlay__/bi_tcxo_ao:clocks:0";
		rpmhcc = "/fragment@1:target:0";
		aopcc = "/fragment@2:target:0";
		usb0 = "/fragment@3:target:0";
		usb_nop_phy = "/fragment@3/__overlay__/dwc3@a600000:usb-phy:4";
		usb2_phy0 = "/fragment@4:target:0";
		qupv3_se8_2uart = "/fragment@5:target:0";
		qupv3_se2_2uart = "/fragment@6:target:0";
		wdog = "/fragment@7:target:0";
		ufsphy_mem = "/fragment@8:target:0";
		pm8150_l5 = "/fragment@8/__overlay__:vdda-phy-supply:0";
		pm8150_l6 = "/fragment@8/__overlay__:vdda-pll-supply:0\0/fragment@9/__overlay__:qcom,vddp-ref-clk-supply:0";
		ufshc_mem = "/fragment@9:target:0";
		ufs_phy_gdsc = "/fragment@9/__overlay__:vdd-hba-supply:0";
		pm8150a_l7 = "/fragment@9/__overlay__:vcc-supply:0\0/fragment@10/__overlay__:vdd-supply:0";
		pm8150_s4 = "/fragment@9/__overlay__:vccq2-supply:0\0/fragment@10/__overlay__:vdd-io-supply:0";
		sdhc_1 = "/fragment@10:target:0";
		sdc1_clk_on = "/fragment@10/__overlay__:pinctrl-0:0";
		sdc1_cmd_on = "/fragment@10/__overlay__:pinctrl-0:4";
		sdc1_data_on = "/fragment@10/__overlay__:pinctrl-0:8";
		sdc1_rclk_on = "/fragment@10/__overlay__:pinctrl-0:12";
		sdc1_clk_off = "/fragment@10/__overlay__:pinctrl-1:0";
		sdc1_cmd_off = "/fragment@10/__overlay__:pinctrl-1:4";
		sdc1_data_off = "/fragment@10/__overlay__:pinctrl-1:8";
		sdc1_rclk_off = "/fragment@10/__overlay__:pinctrl-1:12";
		sdhc_2 = "/fragment@11:target:0";
		pm8150a_l9 = "/fragment@11/__overlay__:vdd-supply:0";
		pm8150a_l6 = "/fragment@11/__overlay__:vdd-io-supply:0";
		sdc2_clk_on = "/fragment@11/__overlay__:pinctrl-0:0";
		sdc2_cmd_on = "/fragment@11/__overlay__:pinctrl-0:4";
		sdc2_data_on = "/fragment@11/__overlay__:pinctrl-0:8";
		sdc2_clk_off = "/fragment@11/__overlay__:pinctrl-1:0";
		sdc2_cmd_off = "/fragment@11/__overlay__:pinctrl-1:4";
		sdc2_data_off = "/fragment@11/__overlay__:pinctrl-1:8";
		qupv3_se9_i2c = "/fragment@12:target:0";
	};

	__local_fixups__ {

		fragment@3 {

			__overlay__ {

				dwc3@a600000 {
					usb-phy = <0x00>;
				};
			};
		};
	};
};
